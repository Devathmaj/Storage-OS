## os-node/buildroot/configs/storageos_qemu_x86_64_defconfig
```kconfig
BR2_x86_64=y
BR2_PACKAGE_HOST_LINUX_HEADERS_CUSTOM_6_12=y
BR2_GLOBAL_PATCH_DIR="board/qemu/patches"
BR2_DOWNLOAD_FORCE_CHECK_HASHES=y

# External tree for osnode package
BR2_EXTERNAL="$(TOPDIR)/external"

# Minimal system configuration
BR2_SYSTEM_DHCP="eth0"
BR2_TARGET_GENERIC_HOSTNAME="storageos"
BR2_TARGET_GENERIC_ISSUE="StorageOS node"
BR2_TARGET_GENERIC_GETTY_PORT="ttyS0"
BR2_ROOTFS_OVERLAY="board/storageos/rootfs-overlay"
BR2_ROOTFS_POST_BUILD_SCRIPT="board/storageos/post-build.sh board/qemu/x86_64/post-build.sh"
BR2_ROOTFS_POST_IMAGE_SCRIPT="board/qemu/post-image.sh"
BR2_ROOTFS_POST_SCRIPT_ARGS="$(BR2_DEFCONFIG)"

# Linux kernel
BR2_LINUX_KERNEL=y
BR2_LINUX_KERNEL_CUSTOM_VERSION=y
BR2_LINUX_KERNEL_CUSTOM_VERSION_VALUE="6.12.47"
BR2_LINUX_KERNEL_USE_CUSTOM_CONFIG=y
BR2_LINUX_KERNEL_CUSTOM_CONFIG_FILE="board/qemu/x86_64/linux.config"
BR2_LINUX_KERNEL_NEEDS_HOST_LIBELF=y

# Minimal rootfs - EXT2 only
BR2_TARGET_ROOTFS_EXT2=y
BR2_TARGET_ROOTFS_EXT2_SIZE="128M"
# BR2_TARGET_ROOTFS_TAR is not set

# Disable unnecessary features
# BR2_PACKAGE_BUSYBOX_SHOW_OTHERS is not set

# Essential core packages
BR2_PACKAGE_E2FSPROGS=y
BR2_PACKAGE_UTIL_LINUX=y
BR2_PACKAGE_UTIL_LINUX_BINARIES=y
BR2_PACKAGE_UTIL_LINUX_FSCK=y
BR2_PACKAGE_IPROUTE2=y
BR2_PACKAGE_IPTABLES=y
BR2_PACKAGE_CURL=y

# StorageOS packages
BR2_PACKAGE_CLOUDFLARED=y
BR2_PACKAGE_OSCORE=y
BR2_PACKAGE_OSNODE=y
BR2_PACKAGE_OS_STORAGE_SERVER=y
BR2_PACKAGE_STORAGEMGR=y

# Disable GUI and graphics
# BR2_PACKAGE_XORG7 is not set
# BR2_PACKAGE_QT5 is not set
# BR2_PACKAGE_QT6 is not set
# BR2_PACKAGE_GTK3 is not set
# BR2_PACKAGE_SDL2 is not set
# BR2_PACKAGE_MESA3D is not set

# Host tools
BR2_PACKAGE_HOST_QEMU=y
BR2_PACKAGE_HOST_QEMU_SYSTEM_MODE=y
```

## os-node/buildroot/package/os-storage-server/Config.in
```kconfig
config BR2_PACKAGE_OS_STORAGE_SERVER
	bool "os-storage-server"
	depends on BR2_PACKAGE_HOST_GO_TARGET_ARCH_SUPPORTS
	depends on BR2_PACKAGE_HOST_GO_TARGET_CGO_LINKING_SUPPORTS
	depends on BR2_TOOLCHAIN_HAS_THREADS
	select BR2_PACKAGE_DQLITE
	help
	  OS Storage Server - Handles file storage and dqlite metadata
	  operations for the distributed storage system. Starts after
	  storage initialization and provides HTTP API for file operations.

	  This server is the core storage backend for StorageOS nodes.
```

## os-node/buildroot/package/oscore/Config.in
```kconfig
config BR2_PACKAGE_OSCORE
	bool "oscore - Optimized file storage system"
	depends on BR2_PACKAGE_CLOUDFLARED
	help
	  High-performance file I/O library with optimizations:
	  - Buffered I/O with 1MB buffers
	  - Memory-mapped file operations
	  - Zero-copy sendfile
	  - Async I/O support
	  - Huge page allocation
	  - Built-in HTTP/TCP server for API communication
	  - Cloudflare Tunnel support for secure remote access
	  - mTLS client for secure server communication

	  This package provides libfs.so, command-line tools,
	  storageos-httpd server, and cloudflare tunnel setup.
```

## os-node/buildroot/package/storagemgr/Config.in
```kconfig
config BR2_PACKAGE_STORAGEMGR
	bool "storagemgr"
	select BR2_PACKAGE_E2FSPROGS
	select BR2_PACKAGE_E2FSPROGS_RESIZE2FS
	select BR2_PACKAGE_E2FSPROGS_E2FSCK
	select BR2_PACKAGE_PARTED
	select BR2_PACKAGE_UTIL_LINUX
	select BR2_PACKAGE_UTIL_LINUX_PARTX
	select BR2_PACKAGE_UTIL_LINUX_LIBBLKID
	select BR2_PACKAGE_UTIL_LINUX_LIBMOUNT
	depends on BR2_USE_MMU
	help
	  Interactive storage manager for dynamic filesystem resizing.
	  
	  This tool allows users to expand or shrink the root filesystem
	  at runtime or boot time. Features include:
	  
	  - Interactive size selection with disk space validation
	  - Safe expansion without unmounting
	  - Safe shrinking with data usage checks
	  - Automatic partition and filesystem resizing
	  
	  Run 'storagemgr' to manage storage allocation.
	  
	  https://github.com/yourusername/storagemgr

if BR2_PACKAGE_STORAGEMGR

comment "storagemgr needs a toolchain w/ threads, dynamic library"
	depends on !BR2_TOOLCHAIN_HAS_THREADS || BR2_STATIC_LIBS

endif
```

## os-node/buildroot/package/storagequota/Config.in
```kconfig
config BR2_PACKAGE_STORAGEQUOTA
	bool "storagequota"
	help
	  Storage quota enforcement daemon for dynamic storage management.
	  Monitors disk usage and enforces user-defined quota limits.
```
